## base_external/package/Text_Detection/Config.in
```kconfig
config BR2_PACKAGE_TEXT_DETECTION
	bool "Text_Detection"
	help
	  Includes the writer executable, finder.sh and tester.sh in the kernel image.
	  Used to understand buildroot external trees and package builds.
```
